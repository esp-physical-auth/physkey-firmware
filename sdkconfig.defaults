## sdkconfig.defaults
```kconfig
# ===== 分区表：使用自定义分区表，扩大 app 分区 =====
CONFIG_PARTITION_TABLE_CUSTOM=y
CONFIG_PARTITION_TABLE_CUSTOM_FILENAME="partitions.csv"

# ===== Flash 大小：4MB =====
CONFIG_ESPTOOLPY_FLASHSIZE_4MB=y
CONFIG_ESPTOOLPY_FLASHSIZE="4MB"

# ===== 蓝牙：启用 NimBLE 协议栈（BLE） =====
CONFIG_BT_ENABLED=y
CONFIG_BT_NIMBLE_ENABLED=y
CONFIG_BT_BLE_ENABLED=y

# NimBLE 设备名与角色
CONFIG_BT_NIMBLE_ROLE_CENTRAL=n
CONFIG_BT_NIMBLE_ROLE_OBSERVER=n
CONFIG_BT_NIMBLE_ROLE_PERIPHERAL=y
CONFIG_BT_NIMBLE_ROLE_BROADCASTER=y

# 支持自定义 GATT（NUS 服务需要）
CONFIG_BT_NIMBLE_MAX_CONNECTIONS=1
CONFIG_BT_NIMBLE_ATT_PREFERRED_MTU=247
# NimBLE host task 栈默认 4096 字节，太小。
# AUTH 命令里的 mbedTLS ECDSA 签名 + base64 解码会吃很多栈，
# 导致 Stack protection fault 崩溃。加到 8192。
CONFIG_BT_NIMBLE_HOST_TASK_STACK_SIZE=8192

# ===== Wi-Fi（用于 SNTP 授时） =====
CONFIG_ESP_WIFI_ENABLED=y

# ===== mbedTLS：启用 SHA1/HMAC（TOTP 需要） =====
CONFIG_MBEDTLS_SHA1_C=y
CONFIG_MBEDTLS_HARDWARE_SHA=y
```
